## prj.conf
```kconfig
# Increased stack due to settings API usage
#CONFIG_SYSTEM_WORKQUEUE_STACK_SIZE=2048

CONFIG_BT=y
CONFIG_LOG=y
CONFIG_BT_SMP=y
CONFIG_BT_SIGNING=y
CONFIG_BT_PERIPHERAL=y
CONFIG_BT_DIS=y
CONFIG_BT_ATT_PREPARE_COUNT=5
CONFIG_BT_BAS=y
CONFIG_BT_HRS=y
CONFIG_BT_IAS=y
#CONFIG_BT_CTS=y
#CONFIG_BT_CTS_HELPER_API=y
CONFIG_BT_PRIVACY=y
CONFIG_BT_DEVICE_NAME="Last Mile parcel"
CONFIG_BT_DEVICE_APPEARANCE=833
CONFIG_BT_DEVICE_NAME_DYNAMIC=y
CONFIG_BT_DEVICE_NAME_MAX=65
CONFIG_BT_GATT_CACHING=n

CONFIG_BT_KEYS_OVERWRITE_OLDEST=y
CONFIG_BT_SETTINGS=y
CONFIG_FLASH=y
CONFIG_FLASH_MAP=y
CONFIG_NVS=y
CONFIG_SETTINGS=y

CONFIG_ENTROPY_GENERATOR=y
```

## src/main.c
```c
/* main.c - Application main entry point */

/*
 * Copyright (c) 2015-2016 Intel Corporation
 *
 * SPDX-License-Identifier: Apache-2.0
 */

#include <zephyr/types.h>
#include <stddef.h>
#include <string.h>
#include <stdio.h>
#include <errno.h>
#include <zephyr/sys/printk.h>
#include <zephyr/sys/byteorder.h>
#include <zephyr/kernel.h>
#include <zephyr/logging/log.h>

#include <zephyr/settings/settings.h>

#include <zephyr/bluetooth/bluetooth.h>
#include <zephyr/bluetooth/gap.h>
#include <zephyr/random/random.h>

/* 

	Broadcast destination number to bollards	
	Listen for reset command from Controller and generate a random number (1-4)

	? Can this just be encoded as the last bit of the BT_UUID_CUSTOM_SERVICE_VAL 
	  Or does it need to be represented as a characteristic of a generic Last Mile service
	?

*/


LOG_MODULE_REGISTER(Last_Mile_Parcel, LOG_LEVEL_INF);


volatile bool last_button = true;

#define DEVICE_NAME CONFIG_BT_DEVICE_NAME
#define DEVICE_NAME_LEN (sizeof(DEVICE_NAME) - 1)
#define RANDOM sys_rand16_get() % 4

/*  Declare the advertising packet */
static const struct bt_data ad[] = {
	/*  Set the advertising flags */
	BT_DATA_BYTES(BT_DATA_FLAGS, BT_LE_AD_NO_BREDR),
	/*  Set the advertising packet data  */
	BT_DATA(BT_DATA_NAME_COMPLETE, DEVICE_NAME, DEVICE_NAME_LEN),

};



/* Declare the URL data to include in the scan response */
unsigned char payload_data[] = { 0x0C, 'B', 'O', 'L', '\0'};

/* Declare the scan response packet */
struct bt_data sd[] = {
	/* Include the payload data in the scan response packet */
	BT_DATA(BT_DATA_URI, payload_data, sizeof(payload_data)),
};


int main(void)
{

	int err;
    //snprintf(payload_data, sizeof(payload_data)+1, "%s%d", payload_data, RANDOM);
    uint8_t rand = RANDOM;
    payload_data[4] = '0'+rand;

	/* Enable the Bluetooth LE stack */
	err = bt_enable(NULL);
	if (err) {
		LOG_ERR("Bluetooth init failed (err %d)\n", err);
		return -1;
	}
        settings_subsys_init();
	if (IS_ENABLED(CONFIG_SETTINGS)) {
		settings_load();
	}

	LOG_INF("Bluetooth initialized\n");
	


	/*  Start advertising */
	err = bt_le_adv_start(BT_LE_ADV_CONN, ad, ARRAY_SIZE(ad), sd, ARRAY_SIZE(sd));
       if (err) {
		LOG_ERR("Advertising failed to start (err %d)\n", err);
		return -1;
	}

	LOG_INF("Advertising successfully started\n");	

	
	while(1) {
		k_msleep(100);	
				
		
		
	}
	return 0;
}
```
