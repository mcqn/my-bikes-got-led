## CMakeLists.txt
```
# SPDX-License-Identifier: Apache-2.0

cmake_minimum_required(VERSION 3.20.0)
find_package(Zephyr REQUIRED HINTS $ENV{ZEPHYR_BASE})
project(peripheral)

target_sources(app PRIVATE
  src/main.c
  src/buttons.c
  src/matrix.c
)
```

## prj.conf
```kconfig
# Increased stack due to settings API usage
CONFIG_SYSTEM_WORKQUEUE_STACK_SIZE=2048

CONFIG_BT=y
CONFIG_LOG=y
CONFIG_BT_SMP=y
CONFIG_BT_SIGNING=y
CONFIG_BT_PERIPHERAL=y
CONFIG_BT_DIS=y
CONFIG_BT_ATT_PREPARE_COUNT=5
CONFIG_BT_BAS=y
CONFIG_BT_HRS=y
CONFIG_BT_IAS=y
#CONFIG_BT_CTS=y
#CONFIG_BT_CTS_HELPER_API=y
CONFIG_BT_PRIVACY=y
CONFIG_BT_DEVICE_NAME="Lastmile_controller"
CONFIG_BT_DEVICE_APPEARANCE=833
CONFIG_BT_DEVICE_NAME_DYNAMIC=y
CONFIG_BT_DEVICE_NAME_MAX=65

CONFIG_BT_KEYS_OVERWRITE_OLDEST=y
CONFIG_BT_SETTINGS=y
CONFIG_FLASH=y
CONFIG_FLASH_MAP=y
CONFIG_NVS=y
CONFIG_SETTINGS=y
```

## src/main.c
```c
/* main.c - Application main entry point */

/*
 * Copyright (c) 2015-2016 Intel Corporation
 *
 * SPDX-License-Identifier: Apache-2.0
 */

#include <zephyr/types.h>
#include <stddef.h>
#include <string.h>
#include <errno.h>
#include <zephyr/sys/printk.h>
#include <zephyr/sys/byteorder.h>
#include <zephyr/kernel.h>
#include <zephyr/logging/log.h>

#include <zephyr/settings/settings.h>

#include <zephyr/bluetooth/bluetooth.h>
#include <zephyr/bluetooth/gap.h>


//See : https://github.com/fduignan/zephyr_bbc_microbit_v2/tree/main
#include "matrix.h"
#include "buttons.h"


/*

Manages the game running with button presses

    A Set the game: Broadcast to all bollards to enter waiting mode
    B Check: Broadcast to all the bollards to check status and display correct/incorrect indicator
    A+B Reset Broadcast to all the Parcels to generate a random destination number 1-4 and broadcast to bollards to enter waiting mode


*/


LOG_MODULE_REGISTER(Last_Mile_Controller, LOG_LEVEL_INF);


volatile bool last_button = true;

#define DEVICE_NAME CONFIG_BT_DEVICE_NAME
#define DEVICE_NAME_LEN (sizeof(DEVICE_NAME) - 1)


/*  Declare the advertising packet */
static const struct bt_data ad[] = {
	/*  Set the advertising flags */
	BT_DATA_BYTES(BT_DATA_FLAGS, BT_LE_AD_NO_BREDR),
	/*  Set the advertising packet data  */
	BT_DATA(BT_DATA_NAME_COMPLETE, DEVICE_NAME, DEVICE_NAME_LEN),

};

/* Declare the URL data to include in the scan response */
static unsigned char check_data[] = { 0x0C, 'C', 'H', 'E', 'C', 'K' };
static unsigned char set_data[] = { 0x0C, 'S', 'E', 'T' };




/* Declare the scan response packet */
struct bt_data sd[] = {
	/* Include the payload data in the scan response packet */
	BT_DATA(BT_DATA_URI, check_data, sizeof(check_data)),
};


void button_a_callback(void)
{


LOG_INF("button A\n");
last_button = false;

/*
	if(get_buttonB()){
		matrix_put_pattern(0x1f,0);
	} else {
		matrix_put_pattern(0,0);
	}
*/
}

void button_b_callback(void)
{
LOG_INF("button B\n");
last_button = true;

}


int main(void)
{

	int err;
	/* Enable the Bluetooth LE stack */
	err = bt_enable(NULL);
	if (err) {
		LOG_ERR("Bluetooth init failed (err %d)\n", err);
		return -1;
	}
        settings_subsys_init();
	if (IS_ENABLED(CONFIG_SETTINGS)) {
		settings_load();
	}

	LOG_INF("Bluetooth initialized\n");
	


	/*  Start advertising */
	err = bt_le_adv_start(BT_LE_ADV_CONN, ad, ARRAY_SIZE(ad), sd, ARRAY_SIZE(sd));
       if (err) {
		LOG_ERR("Advertising failed to start (err %d)\n", err);
		return -1;
	}

	// Initialise microbit io
	int ret;
  	ret = buttons_begin();
  	if (ret < 0)
  	{
		printk("Error initializing the buttons\n");
		return -1;
	}
	ret = matrix_begin();
	if (ret < 0)
  	{
		printk("Error initializing the matrix\n");
		return -2;
	}
	attach_callback_to_button_a(button_a_callback);
	attach_callback_to_button_b(button_b_callback);

	LOG_INF("Advertising successfully started\n");	
	bool current_button = last_button;
	while(1) {
		k_msleep(100);	
		if(current_button != last_button) {
		 	
			LOG_INF("Set data\n");
			if(last_button) {
				sd->data = check_data;
				sd->data_len = sizeof(check_data);
			} else {
				sd->data = set_data;
				sd->data_len = sizeof(set_data);			
			}
			current_button = last_button;

			LOG_INF("Update advertising\n");
			bt_le_adv_update_data(ad, ARRAY_SIZE(ad),
			      sd, ARRAY_SIZE(sd));
			LOG_INF("Return\n");
		}		
		
		
	}
	return 0;
}
```

## src/buttons.c
```c
#include <stdint.h>
#include <zephyr/sys/printk.h>
#include <zephyr/device.h>
#include <zephyr/drivers/gpio.h>
#include <stdio.h>
#include "buttons.h"
// Both buttons are on GPIO0
#define BUTTON_A_PORT_BIT 14
#define BUTTON_B_PORT_BIT 23
static const struct device *gpio_0;


int get_buttonA()
{
	return gpio_pin_get(gpio_0,BUTTON_A_PORT_BIT);
}
int get_buttonB()
{
	return gpio_pin_get(gpio_0,BUTTON_B_PORT_BIT);
}
int buttons_begin()
{
	int ret;
	// Configure the GPIO's 	
	gpio_0=DEVICE_DT_GET(DT_NODELABEL(gpio0));
	if (gpio_0 == NULL)
	{
		printf("Error acquiring GPIO 0 interface\n");
		return -1;
	}
	ret = gpio_pin_configure(gpio_0,BUTTON_A_PORT_BIT,GPIO_INPUT);
	ret = gpio_pin_configure(gpio_0,BUTTON_B_PORT_BIT,GPIO_INPUT);
	return 0;

}

static fptr button_a_user_handler = NULL;
static struct gpio_callback button_a_cb;
static void button_a_handler(const struct device *dev, struct gpio_callback *cb, uint32_t pins)
{
	printk("interrupt\n");
	if (button_a_user_handler)
	{
		button_a_user_handler();
	}
}
int attach_callback_to_button_a(fptr callback_function)
{
	if (gpio_pin_interrupt_configure(gpio_0,BUTTON_A_PORT_BIT,GPIO_INT_EDGE_FALLING) < 0)
	{
		printk("Error configuring interrupt for button A\n");
	}
	gpio_init_callback(&button_a_cb, button_a_handler, (1 << BUTTON_A_PORT_BIT) );	
    if (gpio_add_callback(gpio_0, &button_a_cb) < 0)
	{
		printk("Error adding callback for button A\n");
	}
	else
	{
		// success so far so use the user supplied callback function
		button_a_user_handler = callback_function;
	}

	return 0;
}


//TIDYME

static fptr button_b_user_handler = NULL;
static struct gpio_callback button_b_cb;
static void button_b_handler(const struct device *dev, struct gpio_callback *cb, uint32_t pins)
{
	printk("interrupt\n");
	if (button_b_user_handler)
	{
		button_b_user_handler();
	}
}
int attach_callback_to_button_b(fptr callback_function)
{
	if (gpio_pin_interrupt_configure(gpio_0,BUTTON_B_PORT_BIT,GPIO_INT_EDGE_FALLING) < 0)
	{
		printk("Error configuring interrupt for button B\n");
	}
	gpio_init_callback(&button_b_cb, button_b_handler, (1 << BUTTON_B_PORT_BIT) );	
    if (gpio_add_callback(gpio_0, &button_b_cb) < 0)
	{
		printk("Error adding callback for button B\n");
	}
	else
	{
		// success so far so use the user supplied callback function
		button_b_user_handler = callback_function;
	}

	return 0;
}
```
